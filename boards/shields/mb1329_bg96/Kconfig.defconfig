## boards/shields/mb1329_bg96/Kconfig.defconfig
```kconfig
# Copyright (c) 2020 Thomas Le Roux <thomas.leroux@smile.fr>, SMILE
# SPDX-License-Identifier: Apache-2.0

if SHIELD_MB1329_BG96

if NETWORKING

config MODEM
	default y

config MODEM_SHELL
	default y

config UART_INTERRUPT_DRIVEN
	default y

# extend retry timing to 20 seconds for LTE/LTE-M
config COAP_INIT_ACK_TIMEOUT_MS
	default 20000

endif #NETWORKING

endif # SHIELD_MB1329_BG96
```

## boards/shields/mb1329_bg96/Kconfig.shield
```kconfig
# Copyright (c) 2020 Thomas Le Roux <thomas.leroux@smile.fr>, SMILE
# SPDX-License-Identifier: Apache-2.0

config SHIELD_MB1329_BG96
	def_bool $(shields_list_contains,mb1329_bg96)
```

## boards/shields/quectel_bg9x/Kconfig.shield
```kconfig
# Copyright (c) 2019 Linaro Limited
# SPDX-License-Identifier: Apache-2.0

config SHIELD_QUECTEL_BG9X
	def_bool $(shields_list_contains,quectel_bg9x)
```
